/dts-v1/;
/plugin/;

/ {
	fragment@0 {
		target-path = "/reserved-memory";  // Reference the reserved memory node in the base DTB
		__overlay__ {
			#address-cells = <0x2>;
			#size-cells = <0x2>;
			pico32@70000000 {
				phandle = <0x98>;	
				no-map;
				reg = <0x0 0x70000000 0x0 0x2000000>;
			};
		};
	};

	fragment@1 {
		target-path = "/";  // Apply the following overlay to the root node
		__overlay__ {
			#address-cells = <0x2>;
			#size-cells = <0x2>;
			pico32@88000000 {
				phandle = <0x97>;	
				compatible = "dottavia,pico32-remoteproc";
				memory-region = <0x98>;
				reg = <0x0 0x88000000 0x0 0x00001000>;
			};
		};
	};
};

